## config/boards/shields/caldera/Kconfig.defconfig
```kconfig
if SHIELD_KBLUNIX_LEFT

config ZMK_KEYBOARD_NAME
    default "KBlunix"

config ZMK_SPLIT_ROLE_CENTRAL
    default y

endif

if SHIELD_KBLUNIX_LEFT || SHIELD_KBLUNIX_RIGHT

config ZMK_SPLIT
    default y

endif
```

## config/boards/shields/kblunix/Kconfig.shield
```kconfig
config SHIELD_KBLUNIX_LEFT
    def_bool $(shields_list_contains,kblunix_left)

config SHIELD_KBLUNIX_RIGHT
    def_bool $(shields_list_contains,kblunix_right)
```
